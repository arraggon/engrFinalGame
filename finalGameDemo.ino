#include <Adafruit_CircuitPlayground.h>
#include <Wire.h>
#include <SPI.h>

const uint8_t spGAMES[]             PROGMEM ={0xAA,0x15,0x24,0x2A,0xD6,0xE4,0xB6,0xB6,0x79,0x13,0xB1,0x5C,0xB2,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0x00,0x00};
const uint8_t spOVER[]              PROGMEM ={0xA7,0xD0,0xAE,0x2F,0x50,0xBA,0x9D,0x5C,0xDB,0xFA,0x24,0xCE,0x3A,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0x00,0x00};
const uint8_t spYOU[]               PROGMEM ={0xA5,0xDA,0x0D,0x98,0x23,0x6F,0xF4,0x6A,0x55,0x33,0xA9,0x82,0xC6,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0x00,0x00};
const uint8_t spGOT[]               PROGMEM ={0xA2,0x20,0xBA,0x2A,0xDD,0x13,0x8F,0x2A,0x07,0x13,0x2D,0x5D,0x7B,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0x04,0x3C};
const uint8_t spONE[]               PROGMEM ={0xA6,0xA5,0x36,0xDF,0x89,0xEC,0xA5,0x86,0xDB,0xF9,0x42,0x56,0x9A,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0x9A,0x07};
const uint8_t spTHREE[]             PROGMEM ={0x0C,0x08,0xCA,0x44,0x02,0x1A,0xB0,0x40,0xC8,0x4D,0x15,0x73,0xCB,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0xCC,0x03};
const uint8_t spFOUR[]              PROGMEM ={0xC0,0x00,0x23,0x2D,0x24,0xA0,0x01,0x0B,0x58,0x20,0xC5,0xBC,0xF7,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0x00,0x00};
const uint8_t spFIVE[]              PROGMEM ={0xC0,0x80,0xE8,0xCD,0x46,0xEE,0x9C,0x6F,0x31,0x66,0x39,0xB9,0xF3,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0xD5,0x1F};
const uint8_t spSIX[]               PROGMEM ={0x06,0x98,0xB6,0xC4,0x01,0x2F,0x66,0x46,0x20,0x01,0xD3,0x96,0x18,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0x00,0x00};
const uint8_t spSEVEN[]             PROGMEM ={0x0C,0xF8,0xDE,0x4C,0x02,0x1A,0xD0,0x80,0x05,0x2C,0xB0,0x62,0x17,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0x71,0xF7};
const uint8_t spEIGHT[]             PROGMEM ={0x2D,0x2F,0xC5,0x54,0xA3,0x63,0xB5,0xBC,0x54,0x55,0xCD,0x1E,0x32,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0x81,0x07};
const uint8_t spNINE[]              PROGMEM ={0x80,0x52,0xAA,0x32,0x2B,0xDA,0xB6,0xA9,0xAC,0x95,0x69,0xCD,0x48,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0x00,0xF0};
const uint8_t spZERO[]              PROGMEM ={0xAD,0x59,0x3A,0xC8,0x18,0xFD,0x9E,0xA2,0x99,0x34,0x23,0xE9,0x77,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0x00,0x00};
const uint8_t spGOODBYE[]           PROGMEM ={0xA9,0x49,0xE1,0x54,0x91,0x2D,0xAF,0x22,0x07,0x55,0x29,0x69,0x7B,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0x00,0x00};


int count = 1;

int score = 0;

int holding = 500;
int loading = 100;
int timer = 10;
int level = 0;



bool leftButtonPressed;
bool rightButtonPressed;

bool slideSwitch = CircuitPlayground.slideSwitch();

void setup() {
  Serial.begin(9600);
  CircuitPlayground.begin();
}

void loop() {
  int lightMode;
  int lightTime;
  int lightTimeR;
  int lightTimeL;

  int longerTime;



  bool slideSwitch = CircuitPlayground.slideSwitch();

  CircuitPlayground.clearPixels();
  CircuitPlayground.redLED(LOW);

    

  if (slideSwitch) {

    if (count == 1) {

    int lightMode = random(1,5);//asndjajsdjfasdfjasjdfjawjsdf
    int lightTime = random(1,6);
    int lightTimeR = random(1,6);
    int lightTimeL = random(1,6);

    if (lightTimeR > lightTimeL) {
      longerTime = lightTimeR;
    } else if (lightTimeR <= lightTimeL) {
      longerTime = lightTimeL;
    }

      Serial.print("longer Time is ");
      Serial.println(longerTime);

    switch (lightMode) {
      case 1: 

      Serial.print("lightMode is ");
      Serial.println(lightMode);

      Serial.print("lightTime is ");
      Serial.println(lightTime);

      

      for (int i=0; i<lightTime; i++) {
        CircuitPlayground.setPixelColor(i, 255,   0,   0);
        delay(loading);
      }
      break;

      case 2:
      Serial.print("lightMode is ");
      Serial.println(lightMode);

      Serial.print("lightTimeR is ");
      Serial.println(lightTime);

      

      for (int i=0; i<lightTime; i++) {
        int ll = map(i, 0, 4, 9, 5);
        CircuitPlayground.setPixelColor(ll, 255,   0,   0);
        delay(loading);
      }
      break;

      case 3:
      Serial.print("lightMode is ");
      Serial.println(lightMode);

      Serial.print("lightTimeR is ");
      Serial.println(lightTimeR);

      Serial.print("lightTimeL is ");
      Serial.println(lightTimeL);

      

      for (int i=0; i<lightTimeR || i<lightTimeL; i++) {
        if (i<lightTimeR) {
          CircuitPlayground.setPixelColor(i, 255,   0,   0);
          delay(loading);
        }
        if(i<lightTimeL) {
          CircuitPlayground.setPixelColor(9-i, 255,   0,   0);
          delay(loading);
        }
      }
      break;

      case 4:
      Serial.print("lightMode is ");
      Serial.println(lightMode);

      CircuitPlayground.setPixelColor(0, 255,   0,   0);
      CircuitPlayground.setPixelColor(1, 255,   0,   0);
      CircuitPlayground.setPixelColor(2, 255,   0,   0);
      CircuitPlayground.setPixelColor(3, 255,   0,   0);
      CircuitPlayground.setPixelColor(4, 255,   0,   0);
      CircuitPlayground.setPixelColor(5, 255,   0,   0);
      CircuitPlayground.setPixelColor(6, 255,   0,   0);
      CircuitPlayground.setPixelColor(7, 255,   0,   0);
      CircuitPlayground.setPixelColor(8, 255,   0,   0);
      CircuitPlayground.setPixelColor(9, 255,   0,   0);

      CircuitPlayground.redLED(HIGH);
      break;
    }


    //-------------------------------------------- input part --------------------------------------------

    int right = 0;
    int left = 0;

    int step = 0;

    while (lightMode == 1){
      //M1111111111111111111111111111
      step++;
      
      leftButtonPressed = CircuitPlayground.rightButton();
      rightButtonPressed = CircuitPlayground.leftButton();
      if (right < lightTime && rightButtonPressed) {
        CircuitPlayground.setPixelColor(right, 0,   255,   0);
        right++;
        score++;
        Serial.println(right);
        delay(holding);
      } else if (leftButtonPressed || (step*timer) > ((lightTime*holding)*1.5)) {
        count = 0;
        break;
      } else if (right>=lightTime) {
        passTone();
        break;
      }
      delay(timer);
    }

    while (lightMode == 2){//M22222222222222222222222
      
      step++;

      leftButtonPressed = CircuitPlayground.rightButton();
      rightButtonPressed = CircuitPlayground.leftButton();
      if (left < lightTime && leftButtonPressed) {
        CircuitPlayground.setPixelColor(9-left, 0,   255,   0);
        left++;
        score++;
        Serial.println(left);
        delay(holding);
      } else if (rightButtonPressed || (step*timer) > ((lightTime*holding)*1.5)) {
        count = 0;
        break;
      } else if (left>=lightTime) {
        passTone();
        break;
      }
      delay(timer);
    }    
    
    while (lightMode == 3) {
      
      step++;

      leftButtonPressed = CircuitPlayground.rightButton();
      rightButtonPressed = CircuitPlayground.leftButton();

      if ((right < lightTimeR) && rightButtonPressed) {
        CircuitPlayground.setPixelColor(right, 0,   255,   0);
        delay(holding);
        right++;
        score++;
        Serial.println(right);
      } else if (right>=lightTimeR) {

      }

      if (left < lightTimeL && leftButtonPressed) {
        CircuitPlayground.setPixelColor(9-left, 0,   255,   0);
        delay(holding);
        left++;
        score++;
        Serial.println(left);
      } else if (left>=lightTimeL) {

      }

      

      if ((step*timer) > (longerTime*holding)*1.5) {
        count = 0;
        break;
      }

      if (right>=lightTimeR && left>=lightTimeL) {
        passTone();
        break;
      }
      delay(timer);
    }

    while (lightMode == 4) {

      step++;
      
      leftButtonPressed = CircuitPlayground.rightButton();
      rightButtonPressed = CircuitPlayground.leftButton();

      int lightLevel = CircuitPlayground.lightSensor();

      
      if (leftButtonPressed || rightButtonPressed){
        count = 0;
        break;
      }

      if (lightLevel < 200) {
      CircuitPlayground.setPixelColor(0,   0, 255,   0);
      CircuitPlayground.setPixelColor(1,   0, 255,   0);
      CircuitPlayground.setPixelColor(2,   0, 255,   0);
      CircuitPlayground.setPixelColor(3,   0, 255,   0);
      CircuitPlayground.setPixelColor(4,   0, 255,   0);
      CircuitPlayground.setPixelColor(5,   0, 255,   0);
      CircuitPlayground.setPixelColor(6,   0, 255,   0);
      CircuitPlayground.setPixelColor(7,   0, 255,   0);
      CircuitPlayground.setPixelColor(8,   0, 255,   0);
      CircuitPlayground.setPixelColor(9,   0, 255,   0);
      score++;
      delay(holding);
      break;
      }
      delay(timer);
    }

  Serial.println("-----------");
  Serial.println(score);
  Serial.println(count);
  Serial.println("-----------");

  }

  if (count == 0) {
  CircuitPlayground.speaker.say(spGAMES);
  CircuitPlayground.speaker.say(spOVER);
  delay(1000);
  CircuitPlayground.speaker.say(spGOODBYE);
  CircuitPlayground.speaker.end();
  count = 2;
  }

  }
}

void passTone() {
  CircuitPlayground.playTone(440, 60);
  CircuitPlayground.playTone(466, 60);
  CircuitPlayground.playTone(494, 60);
  CircuitPlayground.playTone(523, 60);
}
